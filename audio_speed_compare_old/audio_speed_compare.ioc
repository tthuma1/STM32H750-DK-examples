# file: audio_speed_compare.ioc
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CORTEX_M7.default_mode_Activation=1
Mcu.Family=STM32H7
Mcu.Name=STM32H750XBHx
Mcu.Package=TFBGA240
NVIC.PriorityGroup=NVIC_PRIORITYGROUP_4
PH0-OSC_IN\ (PH0).Mode=HSE-External-Oscillator
PH0-OSC_IN\ (PH0).Signal=RCC_OSC_IN
PH1-OSC_OUT\ (PH1).Mode=HSE-External-Oscillator
PH1-OSC_OUT\ (PH1).Signal=RCC_OSC_OUT
ProjectManager.HeapSize=0x200
ProjectManager.StackSize=0x400
ProjectManager.TargetToolchain=STM32CubeIDE
RCC.ADCFreq_Value=50390625
RCC.APB1Freq_Value=64000000
RCC.APB2Freq_Value=64000000
RCC.APB3Freq_Value=64000000
RCC.APB4Freq_Value=64000000
RCC.CortexFreq_Value=64000000
RCC.HCLKFreq_Value=64000000
RCC.PLLSourceVirtual=RCC_PLLSOURCE_HSE
RCC.SYSCLKFreq_VALUE=64000000
RCC.USBFreq_Value=50390625
VP_CRC_VS_CRC.Mode=CRC_Activate
VP_MEMORYMAP_VS_MEMORYMAP.Mode=CurAppReg
VP_PDM2PCM_VS_PDM2PCM.Mode=PDM2PCM_Channel
board=custom

// file: Core/Src/main.c
/* USER CODE BEGIN Header */
/**
  ******************************************************************************
  * @file           : main.c
  * @brief          : Main program body
  **************************	*	***************************************************
  * @attention
  *
  * Copyright (c) 2026 STMicroelectronics.
  * All rights reserved.
  *
  * This software is licensed under terms that can be found in the LICENSE file
  * in the root directory of this software component.
  * If no LICENSE file comes with this software, it is provided AS-IS.
  *
  ******************************************************************************
  */
/* USER CODE END Header */
#include "main.h"
#include "pdm2pcm.h"

/* USER CODE BEGIN Includes */
extern SAI_HandleTypeDef haudio_in_sai;   /* defined in stm32h750b_discovery_audio.c */
/* USER CODE END Includes */

CRC_HandleTypeDef hcrc;

/* USER CODE BEGIN PV */
/* PDM record buffer: SAI4 PDM uses BDMA, which can only access D3 SRAM
   (0x38000000). The .D3_SRAM section is mapped to RAM_D3 in the linker
   script. NOLOAD section: not zero-initialised at startup. */
ALIGN_32BYTES (static uint16_t recordPDMBuf[AUDIO_IN_PDM_BUFFER_SIZE]) __attribute__((section(".D3_SRAM")));

/* PCM playback ring buffer, lives in AXI SRAM (DMA2-accessible) */
ALIGN_32BYTES (static uint16_t RecPlayback[AUDIO_BUFF_SIZE]);

static uint32_t playbackPtr = 0;

BSP_AUDIO_Init_t AudioOutInit;
BSP_AUDIO_Init_t AudioInInit;

uint32_t g_work_cycles = 0; /* DWT cycles the CPU spent busy per block (transfer + PDM→PCM) */
uint32_t s_work_start = 0; /* DWT stamp at start of each block's CPU work */
#if SAI_RX_MODE == SAI_RX_MODE_IT
uint32_t s_it_acc    = 0; /* accumulated CPU cycles across all FIFO ISRs for this block */
uint32_t s_isr_entry = 0; /* DWT stamp at entry of the current SAI4_IRQHandler call */
#elif SAI_RX_MODE == SAI_RX_MODE_DMA
static uint32_t s_half_cycles = 0; /* CPU cycles spent in the half-transfer callback */
#endif
/* USER CODE END PV */

void SystemClock_Config(void);
static void MPU_Config(void);
static void MX_CRC_Init(void);
/* USER CODE BEGIN PFP */
static void CPU_CACHE_Enable(void);
/* USER CODE END PFP */

int main(void)
{

  /* USER CODE BEGIN 1 */
  CPU_CACHE_Enable();
  /* USER CODE END 1 */

  /* MPU Configuration--------------------------------------------------------*/
  MPU_Config();

  /* MCU Configuration--------------------------------------------------------*/

  /* Reset of all peripherals, Initializes the Flash interface and the Systick. */
  HAL_Init();

  /* Configure the system clock */
  SystemClock_Config();

  /* Initialize all configured peripherals */
  MX_CRC_Init();
  MX_PDM2PCM_Init();
  /* USER CODE BEGIN 2 */
  /* Enable DWT cycle counter for g_work_cycles measurements */
  CoreDebug->DEMCR |= CoreDebug_DEMCR_TRCENA_Msk;
  DWT->CYCCNT = 0;
  DWT->CTRL  |= DWT_CTRL_CYCCNTENA_Msk;

  AudioOutInit.Device = AUDIO_OUT_DEVICE_HEADPHONE;
  AudioOutInit.ChannelsNbr = 2;
  AudioOutInit.SampleRate = AUDIO_FREQUENCY;
  AudioOutInit.BitsPerSample = AUDIO_RESOLUTION_16B;
  AudioOutInit.Volume = 80;

  AudioInInit.Device = AUDIO_IN_DEVICE_DIGITAL_MIC;
  AudioInInit.ChannelsNbr = 2;
  AudioInInit.SampleRate = AUDIO_FREQUENCY;
  AudioInInit.BitsPerSample = AUDIO_RESOLUTION_16B;
  AudioInInit.Volume = 80;

  /* Instance 1: MEMS microphones via SAI4 PDM interface + BDMA */
  if (BSP_AUDIO_IN_Init(1, &AudioInInit) != BSP_ERROR_NONE)
  {
    Error_Handler();
  }

  /* Instance 0: WM8994 codec via SAI2 + DMA2, line out / headphone */
  if (BSP_AUDIO_OUT_Init(0, &AudioOutInit) != BSP_ERROR_NONE)
  {
    Error_Handler();
  }

  /* Start recording — method selected by SAI_RX_MODE */
#if SAI_RX_MODE == SAI_RX_MODE_DMA
  if (BSP_AUDIO_IN_RecordPDM(1, (uint8_t *)recordPDMBuf, 2U * AUDIO_IN_PDM_BUFFER_SIZE) != BSP_ERROR_NONE)
  {
    Error_Handler();
  }
#elif SAI_RX_MODE == SAI_RX_MODE_IT
  HAL_NVIC_SetPriority(SAI4_IRQn, BSP_AUDIO_IN_IT_PRIORITY, 0);
  HAL_NVIC_EnableIRQ(SAI4_IRQn);
  if (HAL_SAI_Receive_IT(&haudio_in_sai, (uint8_t *)recordPDMBuf,
                         AUDIO_IN_PDM_BUFFER_SIZE / 2) != HAL_OK)
  {
    Error_Handler();
  }
#elif SAI_RX_MODE == SAI_RX_MODE_POLLING
  /* polling is driven from the main while(1) loop below */
#endif

  /* Start playback of the PCM ring buffer that record callbacks fill */
  if (BSP_AUDIO_OUT_Play(0, (uint8_t *)RecPlayback, 2U * AUDIO_BUFF_SIZE) != BSP_ERROR_NONE)
  {
    Error_Handler();
  }
  /* USER CODE END 2 */

  /* Infinite loop */
  /* USER CODE BEGIN WHILE */
  while (1)
  {
#if SAI_RX_MODE == SAI_RX_MODE_POLLING
    s_work_start = DWT->CYCCNT;
    if (HAL_SAI_Receive(&haudio_in_sai, (uint8_t *)recordPDMBuf,
                        AUDIO_IN_PDM_BUFFER_SIZE / 2, HAL_MAX_DELAY) == HAL_OK)
    {
      BSP_AUDIO_IN_PDMToPCM(1, (uint16_t *)&recordPDMBuf[0],
                            &RecPlayback[playbackPtr]);

      SCB_CleanDCache_by_Addr((uint32_t *)&RecPlayback[playbackPtr],
                              AUDIO_IN_PDM_BUFFER_SIZE / 4U);

      playbackPtr += AUDIO_IN_PDM_BUFFER_SIZE / 4U / 2U;
      if (playbackPtr >= AUDIO_BUFF_SIZE) playbackPtr = 0;

      g_work_cycles = DWT->CYCCNT - s_work_start;
    }
#endif /* SAI_RX_MODE_POLLING */
    /* USER CODE END WHILE */

  }
}

void SystemClock_Config(void)
{
  RCC_OscInitTypeDef RCC_OscInitStruct = {0};
  RCC_ClkInitTypeDef RCC_ClkInitStruct = {0};

  /** Supply configuration update enable
  */
  HAL_PWREx_ConfigSupply(PWR_LDO_SUPPLY);

  /** Configure the main internal regulator output voltage
  */
  __HAL_PWR_VOLTAGESCALING_CONFIG(PWR_REGULATOR_VOLTAGE_SCALE1);

  while(!__HAL_PWR_GET_FLAG(PWR_FLAG_VOSRDY)) {}

  /** Initializes the RCC Oscillators according to the specified parameters
  * in the RCC_OscInitTypeDef structure.
  */
  RCC_OscInitStruct.OscillatorType = RCC_OSCILLATORTYPE_HSE;
  RCC_OscInitStruct.HSEState = RCC_HSE_ON;
  RCC_OscInitStruct.HSIState = RCC_HSI_OFF;
  RCC_OscInitStruct.CSIState = RCC_CSI_OFF;
  RCC_OscInitStruct.PLL.PLLState = RCC_PLL_ON;
  RCC_OscInitStruct.PLL.PLLSource = RCC_PLLSOURCE_HSE;
  RCC_OscInitStruct.PLL.PLLM = 5;
  RCC_OscInitStruct.PLL.PLLN = 160;
  RCC_OscInitStruct.PLL.PLLFRACN = 0;
  RCC_OscInitStruct.PLL.PLLP = 2;
  RCC_OscInitStruct.PLL.PLLR = 2;
  RCC_OscInitStruct.PLL.PLLQ = 4;
  RCC_OscInitStruct.PLL.PLLVCOSEL = RCC_PLL1VCOWIDE;
  RCC_OscInitStruct.PLL.PLLRGE = RCC_PLL1VCIRANGE_2;
  if (HAL_RCC_OscConfig(&RCC_OscInitStruct) != HAL_OK)
  {
    Error_Handler();
  }

  /** Initializes the CPU, AHB and APB buses clocks
  */
  RCC_ClkInitStruct.ClockType = RCC_CLOCKTYPE_HCLK|RCC_CLOCKTYPE_SYSCLK
                              |RCC_CLOCKTYPE_PCLK1|RCC_CLOCKTYPE_PCLK2
                              |RCC_CLOCKTYPE_D3PCLK1|RCC_CLOCKTYPE_D1PCLK1;
  RCC_ClkInitStruct.SYSCLKSource = RCC_SYSCLKSOURCE_PLLCLK;
  RCC_ClkInitStruct.SYSCLKDivider = RCC_SYSCLK_DIV1;
  RCC_ClkInitStruct.AHBCLKDivider = RCC_HCLK_DIV2;
  RCC_ClkInitStruct.APB3CLKDivider = RCC_APB3_DIV2;
  RCC_ClkInitStruct.APB1CLKDivider = RCC_APB1_DIV2;
  RCC_ClkInitStruct.APB2CLKDivider = RCC_APB2_DIV2;
  RCC_ClkInitStruct.APB4CLKDivider = RCC_APB4_DIV2;

  if (HAL_RCC_ClockConfig(&RCC_ClkInitStruct, FLASH_LATENCY_4) != HAL_OK)
  {
    Error_Handler();
  }

  /* I/O compensation cell: recommended when buses run at high frequency.
     Requires the CSI and SYSCFG clocks. */
  __HAL_RCC_CSI_ENABLE();
  __HAL_RCC_SYSCFG_CLK_ENABLE();
  HAL_EnableCompensationCell();
}

static void MX_CRC_Init(void)
{

  hcrc.Instance = CRC;
  hcrc.Init.DefaultPolynomialUse = DEFAULT_POLYNOMIAL_ENABLE;
  hcrc.Init.DefaultInitValueUse = DEFAULT_INIT_VALUE_ENABLE;
  hcrc.Init.InputDataInversionMode = CRC_INPUTDATA_INVERSION_NONE;
  hcrc.Init.OutputDataInversionMode = CRC_OUTPUTDATA_INVERSION_DISABLE;
  hcrc.InputDataFormat = CRC_INPUTDATA_FORMAT_BYTES;
  if (HAL_CRC_Init(&hcrc) != HAL_OK)
  {
    Error_Handler();
  }
  __HAL_CRC_DR_RESET(&hcrc);

}

/* USER CODE BEGIN 4 */
/*------------------------------------------------------------------------------
       Audio record callbacks: convert each completed PDM half-buffer to PCM
       and append it to the playback ring buffer.
  ----------------------------------------------------------------------------*/

/**
  * @brief  Second half of the PDM record buffer is ready.
  * @param  Instance Audio in instance (1 = digital MEMS microphones)
  * @retval None
  */
void BSP_AUDIO_IN_TransferComplete_CallBack(uint32_t Instance)
{
  if (Instance == 1U)
  {
#if SAI_RX_MODE == SAI_RX_MODE_DMA
    /* DMA: stamp here — BDMA filled the buffer, CPU work starts now */
    s_work_start = DWT->CYCCNT;
#endif

#if SAI_RX_MODE == SAI_RX_MODE_IT
    /* IT ping-pong: alternate between the two half-buffers */
    static uint8_t it_phase = 0;
    uint16_t *pdm_src = (it_phase == 0)
                        ? (uint16_t *)&recordPDMBuf[0]
                        : (uint16_t *)&recordPDMBuf[AUDIO_IN_PDM_BUFFER_SIZE / 2];
#else
    /* DMA complete callback = second half is ready */
    uint16_t *pdm_src = (uint16_t *)&recordPDMBuf[AUDIO_IN_PDM_BUFFER_SIZE / 2U];
    SCB_InvalidateDCache_by_Addr((uint32_t *)pdm_src, sizeof(recordPDMBuf) / 2U);
#endif

    BSP_AUDIO_IN_PDMToPCM(Instance, pdm_src, &RecPlayback[playbackPtr]);

    SCB_CleanDCache_by_Addr((uint32_t *)&RecPlayback[playbackPtr],
                            AUDIO_IN_PDM_BUFFER_SIZE / 4U);

    playbackPtr += AUDIO_IN_PDM_BUFFER_SIZE / 4U / 2U;
    if (playbackPtr >= AUDIO_BUFF_SIZE) playbackPtr = 0;

#if SAI_RX_MODE == SAI_RX_MODE_IT
    /* s_it_acc = CPU time in ISRs 1..N-1; s_isr_entry = entry of the last ISR.
       Together they give total CPU-active time excluding idle gaps. */
    g_work_cycles = s_it_acc + (DWT->CYCCNT - s_isr_entry);
#elif SAI_RX_MODE == SAI_RX_MODE_DMA
    /* Sum half + complete callback work so g_work_cycles reflects the full block */
    g_work_cycles = s_half_cycles + (DWT->CYCCNT - s_work_start);
#endif

#if SAI_RX_MODE == SAI_RX_MODE_IT
    it_phase ^= 1;
    uint16_t *next_buf = (it_phase == 0)
                         ? &recordPDMBuf[0]
                         : &recordPDMBuf[AUDIO_IN_PDM_BUFFER_SIZE / 2];
    HAL_SAI_Receive_IT(&haudio_in_sai, (uint8_t *)next_buf,
                       AUDIO_IN_PDM_BUFFER_SIZE / 2);
#endif
  }
}

/**
  * @brief  First half of the PDM record buffer is ready.
  * @param  Instance Audio in instance (1 = digital MEMS microphones)
  * @retval None
  */
void BSP_AUDIO_IN_HalfTransfer_CallBack(uint32_t Instance)
{
#if SAI_RX_MODE == SAI_RX_MODE_DMA
  if (Instance == 1U)
  {
    s_work_start = DWT->CYCCNT;

    SCB_InvalidateDCache_by_Addr((uint32_t *)&recordPDMBuf[0],
                                 sizeof(recordPDMBuf) / 2U);

    BSP_AUDIO_IN_PDMToPCM(Instance,
                          (uint16_t *)&recordPDMBuf[0],
                          &RecPlayback[playbackPtr]);

    SCB_CleanDCache_by_Addr((uint32_t *)&RecPlayback[playbackPtr],
                            AUDIO_IN_PDM_BUFFER_SIZE / 4U);

    playbackPtr += AUDIO_IN_PDM_BUFFER_SIZE / 4U / 2U;
    if (playbackPtr >= AUDIO_BUFF_SIZE) playbackPtr = 0;

    s_half_cycles = DWT->CYCCNT - s_work_start;
  }
#endif /* SAI_RX_MODE_DMA */
}

/**
  * @brief  Manages the DMA FIFO error event.
  * @param  Instance Audio out instance
  * @retval None
  */
void BSP_AUDIO_OUT_Error_CallBack(uint32_t Interface)
{
  Error_Handler();
}

/**
  * @brief  CPU L1-Cache enable.
  * @param  None
  * @retval None
  */
static void CPU_CACHE_Enable(void)
{
  /* Enable I-Cache */
  SCB_EnableICache();

  /* Enable D-Cache */
  SCB_EnableDCache();
}

/* USER CODE END 4 */

 /* MPU Configuration */

void MPU_Config(void)
{
  MPU_Region_InitTypeDef MPU_InitStruct = {0};

  /* Disables the MPU */
  HAL_MPU_Disable();

  /** Initializes and configures the Region and the memory to be protected
  */
  MPU_InitStruct.Enable = MPU_REGION_ENABLE;
  MPU_InitStruct.Number = MPU_REGION_NUMBER0;
  MPU_InitStruct.BaseAddress = 0x0;
  MPU_InitStruct.Size = MPU_REGION_SIZE_4GB;
  MPU_InitStruct.SubRegionDisable = 0x87;
  MPU_InitStruct.TypeExtField = MPU_TEX_LEVEL0;
  MPU_InitStruct.AccessPermission = MPU_REGION_NO_ACCESS;
  MPU_InitStruct.DisableExec = MPU_INSTRUCTION_ACCESS_DISABLE;
  MPU_InitStruct.IsShareable = MPU_ACCESS_SHAREABLE;
  MPU_InitStruct.IsCacheable = MPU_ACCESS_NOT_CACHEABLE;
  MPU_InitStruct.IsBufferable = MPU_ACCESS_NOT_BUFFERABLE;

  HAL_MPU_ConfigRegion(&MPU_InitStruct);
  /* Enables the MPU */
  HAL_MPU_Enable(MPU_PRIVILEGED_DEFAULT);

}

void Error_Handler(void)
{
  __disable_irq();
  while (1)
  {
  }
}
